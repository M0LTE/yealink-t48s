## buildroot/Config.in
```kconfig
# SPDX-License-Identifier: GPL-2.0-or-later
source "$BR2_EXTERNAL_T48S_PATH/package/t48s-tools/Config.in"
source "$BR2_EXTERNAL_T48S_PATH/package/libt48/Config.in"
source "$BR2_EXTERNAL_T48S_PATH/package/t48-shell/Config.in"
source "$BR2_EXTERNAL_T48S_PATH/package/t48-audiod/Config.in"
source "$BR2_EXTERNAL_T48S_PATH/package/libg722/Config.in"
source "$BR2_EXTERNAL_T48S_PATH/package/libre/Config.in"
source "$BR2_EXTERNAL_T48S_PATH/package/baresip/Config.in"
```

## buildroot/package/baresip/Config.in
```kconfig
# SPDX-License-Identifier: GPL-2.0-or-later
config BR2_PACKAGE_BARESIP
	bool "baresip"
	depends on BR2_INSTALL_LIBSTDCPP # CMake checks atomics in C++
	select BR2_PACKAGE_LIBRE
	select BR2_PACKAGE_LIBG722
	select BR2_PACKAGE_OPUS # fixed point, as the target is soft-float
	select BR2_PACKAGE_MBEDTLS
	help
	  baresip built as in sip/build.sh: static, with the modules
	  listed there compiled in, including our t48audio from
	  sip/modules. Installs /usr/bin/baresip, the t48-sip start
	  script, the config as /usr/share/t48/sip/config, the settings
	  template sip.example beside it and the licence texts. Nothing
	  starts it at boot.

	  https://github.com/baresip/baresip
```

## buildroot/package/libg722/Config.in
```kconfig
# SPDX-License-Identifier: GPL-2.0-or-later
config BR2_PACKAGE_LIBG722
	bool "libg722"
	help
	  sippy's G.722 codec (two C files), for baresip's libg722
	  module. Static library and headers in staging only.

	  https://github.com/sippy/libg722
```

## buildroot/package/libre/Config.in
```kconfig
# SPDX-License-Identifier: GPL-2.0-or-later
config BR2_PACKAGE_LIBRE
	bool "libre"
	depends on BR2_INSTALL_LIBSTDCPP # CMake checks atomics in C++
	select BR2_PACKAGE_OPENSSL
	help
	  libre, baresip's SIP, RTP and networking library, built as in
	  sip/build.sh: static, with OpenSSL for SIP over TLS, SRTP and
	  the hashes digest login and STUN need, and the patch in
	  sip/patches for our 3.6 kernel headers. Staging only.

	  https://github.com/baresip/re
```

## buildroot/package/libt48/Config.in
```kconfig
# SPDX-License-Identifier: GPL-2.0-or-later
config BR2_PACKAGE_LIBT48
	bool "libt48"
	help
	  The app library for the T48S, from libt48/ in this repo: a
	  static library and its headers in staging (so the SDK has
	  them), and the example clock app installed on the target as
	  /usr/share/t48/apps/clock.
```

## buildroot/package/t48-audiod/Config.in
```kconfig
# SPDX-License-Identifier: GPL-2.0-or-later
config BR2_PACKAGE_T48_AUDIOD
	bool "t48-audiod"
	help
	  The audio service and its control tool, from audiod/ in this
	  repo: /usr/bin/t48-audiod and /usr/bin/t48-audioctl. Installed
	  only; nothing starts it at boot.
```

## buildroot/package/t48-shell/Config.in
```kconfig
# SPDX-License-Identifier: GPL-2.0-or-later
config BR2_PACKAGE_T48_SHELL
	bool "t48-shell"
	select BR2_PACKAGE_LIBT48
	help
	  The T48S shell, from shell/ in this repo: owns the screen and
	  the input devices, shows the idle screen and the launcher and
	  runs the apps in /usr/share/t48/apps and /data/apps.
	  Installed as /usr/bin/t48-shell; the board's inittab starts it
	  on tty1.
```

## buildroot/package/t48-web/Config.in
```kconfig
# SPDX-License-Identifier: GPL-2.0-or-later
config BR2_PACKAGE_T48_WEB
	bool "t48-web"
	select BR2_PACKAGE_LIBT48
	select BR2_PACKAGE_T48_SHELL
	help
	  The phone's web setup page, from webconfig/ in this repo: a small
	  HTTP server for the LAN, off until the owner turns it on at
	  the phone's screen. See docs/web.md.
```

## buildroot/package/t48s-tools/Config.in
```kconfig
# SPDX-License-Identifier: GPL-2.0-or-later
config BR2_PACKAGE_T48S_TOOLS
	bool "t48s-tools"
	help
	  Our test programs for the T48S, from native/ in this repo:
	  keytest, touchtest, membanner, cpubench, and the microphone
	  tools t48rec and t48mix. The screen fonts are
	  committed in native/gen (make -C native fonts regenerates them).
```

## kernel6/drivers/Kconfig
```kconfig
# SPDX-License-Identifier: GPL-2.0
menu "Yealink SIP-T48S drivers"
	depends on ARCH_BCMRING

config GPIO_BCMRING
	bool "GPIO banks of the BCM11107 family"
	depends on GPIOLIB

config T48S_KEYPAD
	bool "T48S keypad and hook switch"
	depends on INPUT

config T48S_HOLTEK
	bool "T48S Holtek chip (its watchdog, the message lamp)"
	depends on NEW_LEDS && LEDS_CLASS

config T48S_BACKLIGHT
	bool "T48S screen backlight"
	depends on BACKLIGHT_CLASS_DEVICE

config T48S_TOUCH
	bool "T48S touchscreen (TSC2046 on the PL022, polled)"
	depends on INPUT

config T48S_ETH
	bool "T48S Ethernet (CPU port of the on-chip switch)"
	depends on NETDEVICES && ETHERNET

config T48S_AUDIO
	bool "T48S audio (BCM11188 APM codecs, ALSA)"
	depends on SND = y
	select SND_PCM

config T48S_NAND
	bool "T48S NAND flash, read-only"
	depends on MTD_RAW_NAND = y

endmenu
```
