// SPDX-License-Identifier: GPL-2.0
/*
 * Yealink SIP-T48S, experiment: the touchscreen through the kernel's own
 * drivers (SPI core, spi-pl022, ads7846, pen-down as a GPIO interrupt) in
 * place of drivers/t48s_touch.c. Build with
 *   DTS=bcm11188-yealink-t48s-ads7846 EXTRA_CONFIG=kernel6/ads7846.config
 * Not the default: the input device then has another name and none of the
 * test hooks our userspace and tools use (kernel6/README.md).
 */
#include <dt-bindings/interrupt-controller/irq.h>
#include "bcm11188-yealink-t48s.dts"

&spi {
	status = "okay";
	cs-gpios = <&gpio0 25 GPIO_ACTIVE_LOW>;

	touchscreen@0 {
		compatible = "ti,tsc2046";
		reg = <0>;
		spi-max-frequency = <2000000>;
		interrupt-parent = <&gpio0>;
		interrupts = <26 IRQ_TYPE_EDGE_FALLING>;
		pendown-gpio = <&gpio0 26 GPIO_ACTIVE_LOW>;
		ti,x-min = /bits/ 16 <0>;
		ti,x-max = /bits/ 16 <4095>;
		ti,y-min = /bits/ 16 <0>;
		ti,y-max = /bits/ 16 <4095>;
		ti,x-plate-ohms = /bits/ 16 <600>;
		ti,pressure-max = /bits/ 16 <4095>;
		ti,debounce-max = /bits/ 16 <10>;
		ti,debounce-tol = /bits/ 16 <50>;
		ti,debounce-rep = /bits/ 16 <1>;
		ti,settle-delay-usec = /bits/ 16 <150>;
		ti,keep-vref-on = <0>;
	};
};
